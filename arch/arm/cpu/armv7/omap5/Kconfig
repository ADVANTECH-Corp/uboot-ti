## arch/arm/cpu/armv7/omap5/Kconfig
```kconfig
if OMAP54XX

choice
	prompt "OMAP5 board select"
	optional

config TARGET_CM_T54
	bool "CompuLab CM-T54"

config TARGET_OMAP5_UEVM
	bool "TI OMAP5 uEVM board"

config TARGET_DRA7XX_EVM
	bool "TI DRA7XX"
	select TI_I2C_BOARD_DETECT

config TARGET_AM57XX_EVM
	bool "AM57XX"
	select TI_I2C_BOARD_DETECT

config TARGET_EBC_GF33A1_2G
	bool "Advantech EBC-GF33 platform for hw version a1"
	select TI_I2C_BOARD_DETECT
	select TARGET_ADVANTECH

config TARGET_EBC_GF33B1_2G
	bool "Advantech EBC-GF33 platform for hw version b1"
	select TI_I2C_BOARD_DETECT
	select TARGET_ADVANTECH

config TARGET_ROM7510A1_2G
	bool "Advantech ROM7510 platform for hw version a1"
	select TI_I2C_BOARD_DETECT
	select TARGET_ADVANTECH

endchoice

config SYS_SOC
	default "omap5"

source "board/compulab/cm_t54/Kconfig"
source "board/ti/omap5_uevm/Kconfig"
source "board/ti/dra7xx/Kconfig"
source "board/ti/am57xx/Kconfig"
source "board/ti/advantech/Kconfig"

if TARGET_DRA7XX_EVM || TARGET_AM57XX_EVM || TARGET_ADVANTECH
menu "Voltage Domain OPP selections"

choice
	prompt "MPU Voltage Domain"
	default DRA7_MPU_OPP_NOM
        help
	  Select the OPP for the MPU voltage domain on DRA7xx & AM57xx SoCs

config DRA7_MPU_OPP_NOM
	bool "OPP NOM"

endchoice

choice
	prompt "DSPEVE Voltage Domain"
        help
	  Select the OPP for the DSPEVE voltage domain on DRA7xx and AM57xx SoCs

config DRA7_DSPEVE_OPP_NOM
	bool "OPP NOM"

config DRA7_DSPEVE_OPP_OD
	bool "OPP OD"

config DRA7_DSPEVE_OPP_HIGH
	bool "OPP HIGH"

endchoice

choice
	prompt "IVA Voltage Domain"
        help
	  Select the OPP for the IVA voltage domain on DRA7xx and AM57xx SoCs

config DRA7_IVA_OPP_NOM
	bool "OPP NOM"

config DRA7_IVA_OPP_OD
	bool "OPP OD"

config DRA7_IVA_OPP_HIGH
	bool "OPP HIGH"

endchoice

choice
	prompt "GPU Voltage Domain"
        help
	  Select the OPP for the GPU voltage domain on DRA7xx and AM57xx SoCs

config DRA7_GPU_OPP_NOM
	bool "OPP NOM"

config DRA7_GPU_OPP_OD
	bool "OPP OD"

config DRA7_GPU_OPP_HIGH
	bool "OPP HIGH"

endchoice

endmenu
endif

endif
```

## board/ti/advantech/Kconfig
```kconfig
config TARGET_AM57XX_ADVANTECH
	bool "Support Advantech platform"

if TARGET_AM57XX_ADVANTECH

config SYS_VENDOR
	default "ti"

config SYS_BOARD
	default "advantech"

if TARGET_EBC_GF33A1_2G
config SYS_BOARD_NAME
	string
	default "gf33a1"

config SYS_CONFIG_NAME
	default "am57xx_gf33a1"
endif

if TARGET_EBC_GF33B1_2G
config SYS_BOARD_NAME
	string
	default "gf33b1"

config SYS_CONFIG_NAME
	default "am57xx_gf33b1"
endif

if TARGET_ROM7510A1_2G
config SYS_BOARD_NAME
	string
	default "rom7510a1"

config SYS_CONFIG_NAME
	default "am57xx_rom7510a1"
endif

if TARGET_ROM7510A2_2G
config SYS_BOARD_NAME
        string
        default "rom7510a2"

config SYS_CONFIG_NAME
        default "am57xx_rom7510a2"
endif

config CONS_INDEX
        int "UART used for console"
        range 1 6
        default 3
        help
          The AM57x (and DRA7xx) SoC has a total of 6 UARTs available to it.
          Depending on your specific board you may want something other than UART3
          here.

source "board/ti/common/Kconfig"

endif
```

## board/ti/am335x_adv/Kconfig
```kconfig
config TARGET_AM335X_ADVANTECH
	bool "Support AM335X Advantech platform"

if TARGET_AM335X_ADVANTECH || TARGET_AM335X_ADVANTECH_MINI

config SYS_BOARD
	default "am335x_adv"

config SYS_VENDOR
	default "ti"

config SYS_SOC
	default "am33xx"

if TARGET_EPCR3220A1_1G

config SYS_BOARD_NAME
        string
	default "epcr3220a1"

config SYS_CONFIG_NAME
	default "am335x_epcr3220"

endif

config NOR
	bool "Support for NOR flash"
	help
	  The AM335x SoC supports having a NOR flash connected to the GPMC.
	  In practice this is seen as a NOR flash module connected to the
	  "memory cape" for the BeagleBone family.

source "board/ti/common/Kconfig"

endif
```

## board/ti/am57xx_adv/Kconfig
```kconfig
if TARGET_AM57XX_ADVANTECH

config SYS_VENDOR
	default "ti"

config SYS_BOARD
	default "am57xx_adv"

config TARGET_ROM7510A1_2G
	bool "Advantech ROM7510 platform for hw version a101-1"

if TARGET_ROM7510A1_2G
config SYS_BOARD_NAME
	string
	default "rom7510a1"

config SYS_CONFIG_NAME
	default "am57xx_rom7510a1"
endif

config TARGET_ROM7510A2_2G
        bool "Advantech ROM7510 platform for hw version a101-3"

if TARGET_ROM7510A2_2G
config SYS_BOARD_NAME
        string
        default "rom7510a2"

config SYS_CONFIG_NAME
        default "am57xx_rom7510a2"
endif

config CONS_INDEX
        int "UART used for console"
        range 1 6
        default 3
        help
          The AM57x (and DRA7xx) SoC has a total of 6 UARTs available to it.
          Depending on your specific board you may want something other than UART3
          here.

source "board/ti/common/Kconfig"

endif
```

## board/ti/am62x_adv/Kconfig
```kconfig
# SPDX-License-Identifier: GPL-2.0+
#
# Copyright (C) 2020-2022 Texas Instruments Incorporated - https://www.ti.com/
#	Suman Anna <s-anna@ti.com>

choice
	prompt "TI K3 AM62x based boards"
	optional

config TARGET_AM62x_A53_RS10
	bool "TI K3 based AM62x RS10 running on A53"
	select ARM64
	select SOC_K3_AM625
	imply BOARD
	imply SPL_BOARD
	imply TI_I2C_BOARD_DETECT

config TARGET_AM62x_R5_RS10
	bool "TI K3 based AM62x RS10 running on R5"
	select CPU_V7R
	select SYS_THUMB_BUILD
	select K3_LOAD_SYSFW
	select SOC_K3_AM625
	select RAM
	select SPL_RAM
	select K3_DDRSS
	imply SYS_K3_SPL_ATF
	imply TI_I2C_BOARD_DETECT

endchoice

if TARGET_AM62x_A53_RS10

config SYS_BOARD
       default "am62x_adv"

config SYS_VENDOR
       default "ti"

config SYS_CONFIG_NAME
       default "am62x_rs10"

source "board/ti/common/Kconfig"

endif

if TARGET_AM62x_R5_RS10

config SYS_BOARD
       default "am62x_adv"

config SYS_VENDOR
       default "ti"

config SYS_CONFIG_NAME
       default "am62x_rs10"

config SPL_LDSCRIPT
	default "arch/arm/mach-omap2/u-boot-spl.lds"

source "board/ti/common/Kconfig"

endif
```

## drivers/watchdog/Kconfig
```kconfig
menu "Watchdog Support"

config WATCHDOG
	bool "Enable watchdog"
	help
	  Enable watchdog.
	  
config C8051_WATCHDOG
	bool "Enable C8051 watchdog drivers"
	depends on WATCHDOG
	help
	  Enable c8051 watchdog.

endmenu
```
