// SPDX-License-Identifier: GPL-2.0
/*
 * AM625 SK dts file for R5 SPL
 * Copyright (C) 2021-2022 Texas Instruments Incorporated - https://www.ti.com/
 */

#include "k3-am62x-rs10.dts"
#include "k3-am62x-rs10-ddr4-1600MTs.dtsi"
#include "k3-am62-ddr.dtsi"

#include "k3-am62x-rs10-u-boot.dtsi"
#include "k3-am62x-r5-rs10-common.dtsi"
