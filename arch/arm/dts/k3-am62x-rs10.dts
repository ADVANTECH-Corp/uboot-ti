// SPDX-License-Identifier: GPL-2.0
/*
 * AM625 SK: https://www.ti.com/lit/zip/sprr448
 *
 * Copyright (C) 2021-2022 Texas Instruments Incorporated - https://www.ti.com/
 */

/dts-v1/;

#include "k3-am62x-rs10-common.dtsi"

/ {
	compatible =  "ti,am625-sk", "ti,am625";
	model = "Advantech AM62x rs10";
};
